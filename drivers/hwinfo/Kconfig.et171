## drivers/hwinfo/Kconfig.et171
```kconfig
# Copyright 2026 Egis Technology Inc.
# SPDX-License-Identifier: Apache-2.0

config HWINFO_ET171
	bool "Egis et171 hwinfo"
	default y
	depends on SOC_EGIS_ET171
	select HWINFO_HAS_DRIVER
	help
	  Enable Egis et171 hwinfo driver
```

## drivers/pinctrl/Kconfig.et171
```kconfig
# Copyright (c) 2025 Egis Technology Inc.
# SPDX-License-Identifier: Apache-2.0

config PINCTRL_ET171
	bool "Egis et171 pin controller"
	default y
	depends on DT_HAS_EGIS_ET171_PINCTRL_ENABLED
	help
	  Enables Egis et171 pin controller
```

## dts/bindings/mtd/andestech,qspi-nor-xip.yaml
```yaml
#
# Copyright (c) 2025, The ChromiumOS Authors.
#
# SPDX-License-Identifier: Apache-2.0
#

compatible: "andestech,qspi-nor-xip"

description:
  Flash SPI-NOR chip used for XIP, connected to an Andes SPI controller.

include: "base.yaml"

properties:
  size:
    type: int
    description: |
      The size in bytes.

  spi-max-frequency:
    type: int
    description: Maximum clock frequency of device's SPI interface in Hz.
```
